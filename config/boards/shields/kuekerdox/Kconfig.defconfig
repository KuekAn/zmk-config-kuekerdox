## config/boards/shields/kuekerdox/Kconfig.defconfig
```kconfig
if SHIELD_KUEKERDOX_LEFT

config ZMK_KEYBOARD_NAME
    default "KuekerDox"

config ZMK_SPLIT_ROLE_CENTRAL
    default y

endif

if SHIELD_KUEKERDOX_LEFT || SHIELD_KUEKERDOX_RIGHT

config ZMK_SPLIT
    default y

endif
```

## config/boards/shields/kuekerdox/Kconfig.shield
```kconfig
config SHIELD_KUEKERDOX_LEFT
    def_bool $(shields_list_contains,kuekerdox_left)

config SHIELD_KUEKERDOX_RIGHT
    def_bool $(shields_list_contains,kuekerdox_right)
```
